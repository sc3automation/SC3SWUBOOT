## board/sc3/mcb11/Kconfig
```kconfig
if TARGET_AM43XX_MCB11

config SYS_BOARD
	default "mcb11"

config SYS_VENDOR
	default "sc3"

config SYS_SOC
	default "am33xx"

config SYS_CONFIG_NAME
	default "am43xx_mcb11"

source "board/ti/common/Kconfig"

endif
```
